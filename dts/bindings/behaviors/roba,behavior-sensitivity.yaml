## dts/bindings/behaviors/roba,behavior-sensitivity.yaml
```yaml
description: Adjust roBa trackball or scroll sensitivity

compatible: "roba,behavior-sensitivity"

include: two_param.yaml
```

## dts/bindings/input/roba,input-processor-sensitivity.yaml
```yaml
description: Scale roBa pointer or scroll movement using the current sensitivity

compatible: "roba,input-processor-sensitivity"

properties:
  mode:
    type: string
    required: true
    enum:
      - pointer
      - scroll
  "#input-processor-cells":
    type: int
    required: true
    const: 0
  track-remainders:
    type: boolean
```
